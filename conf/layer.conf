## conf/layer.conf
```bitbake
# We have a conf and classes directory, add to BBPATH
BBPATH .= ":${LAYERDIR}"

# We have recipes-* directories, add to BBFILES
BBFILES += "${LAYERDIR}/recipes-*/*/*.bb \
            ${LAYERDIR}/recipes-*/*/*.bbappend"

BBFILE_COLLECTIONS += "meta-toradex-framos"
BBFILE_PATTERN_meta-toradex-framos = "^${LAYERDIR}/"
BBFILE_PRIORITY_meta-toradex-framos = "23"

LAYERDEPENDS_meta-toradex-framos = "core"
LAYERSERIES_COMPAT_meta-toradex-framos = "scarthgap"

TEZI_EXTERNAL_KERNEL_DEVICETREE_ADDED:verdin-imx8mp = " verdin-imx8mp_imx662_overlay.dtbo verdin-imx8mp_imx676_overlay.dtbo verdin-imx8mp_imx678_overlay.dtbo "

# imx662 overlay is configured as default. To start directly applying another overlay,
# replace 'verdin-imx8mp_imx662_overlay.dtbo' by the desired overlay in the following variable:
TEZI_EXTERNAL_KERNEL_DEVICETREE_BOOT:append:verdin-imx8mp = " verdin-imx8mp_imx662_overlay.dtbo"

MACHINE_EXTRA_RDEPENDS += " imx662 imx676 imx678"
```
